## boards/nios2/sockit/sockit_defconfig
```kconfig
CONFIG_NIOS2=y
CONFIG_SOC_NIOS2FS_ZEPHYR=y
CONFIG_BOARD_SOCKIT=y
CONFIG_HAS_ALTERA_HAL=y
CONFIG_CONSOLE=y
CONFIG_PRINTK=y
CONFIG_SERIAL=y
#CONFIG_UART_NS16550=y
CONFIG_UART_NS16550=n
CONFIG_UART_CONSOLE=y
CONFIG_XIP=n
CONFIG_INCLUDE_RESET_VECTOR=n
```

## soc/nios2/nios2fs-zephyr/Kconfig.soc
```kconfig
config SOC_NIOS2FS_ZEPHYR
	bool "Nios IIf - Zephyr SocKit Configuration"
	select HAS_MUL_INSTRUCTION
	select HAS_DIV_INSTRUCTION
```
